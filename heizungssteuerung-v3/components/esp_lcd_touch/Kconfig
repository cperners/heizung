## heizungssteuerung-v3/components/esp_lcd_touch/Kconfig
```kconfig
rsource "../../.local/display-dependencies/esp-bsp/components/lcd_touch/esp_lcd_touch/Kconfig"
```

## heizungssteuerung-v3/main/Kconfig.projbuild
```kconfig
menu "Heizungssteuerung"
config HEATING_TOUCH_DISPLAY
    bool "Waveshare 7-DSI-TOUCH-C aktivieren"
    default n
    help
        EK79007 1024x600, GT911 auf I2C GPIO7/8. Benoetigt PSRAM.

config HEATING_ACTUATORS_ENABLED
    bool "Lastausgaenge nach abgeschlossener Inbetriebnahme freigeben"
    default n
    help
        Erst nach Pruefung von Relaispolaritaet, Sensoren und unabhängigen
        Kesselsicherheiten aktivieren. Ohne Freigabe bleiben alle Relais AUS.
config HEATING_RELAY_ACTIVE_LOW
    bool "Alle Relais sind aktiv LOW"
    default n
config HEATING_MQTT_URI
    string "MQTT Broker URI (mqtt://host:1883 oder mqtts://host:8883)"
    default "mqtt://192.168.0.1:1883"
config HEATING_MQTT_USER
    string "MQTT Benutzer"
    default ""
config HEATING_MQTT_PASSWORD
    string "MQTT Passwort"
    default ""
config HEATING_PHY_ADDR
    int "IP101 PHY-Adresse (-1: automatische Erkennung)"
    range -1 31
    default -1
config HEATING_WEB_PASSWORD
    string "Web-Kennwort fuer Benutzer admin (leer: nur Anzeige)"
    default ""
    help
        Nicht mit dem MQTT-Passwort verwechseln. HTTP Basic Auth im lokalen
        Netz, unverschluesselt. Ohne Kennwort sind alle Web-Aenderungen gesperrt.
config HEATING_WEB_USERNAME
    string "Web-Benutzer fuer die Ersteinrichtung"
    default "admin"
endmenu
```

## heizungssteuerung-v3/sdkconfig.defaults
```kconfig
CONFIG_IDF_TARGET="esp32p4"
CONFIG_ETH_USE_ESP32_EMAC=y
CONFIG_ESP_TASK_WDT_EN=y
CONFIG_ESP_TASK_WDT_INIT=y
CONFIG_ESP_TASK_WDT_TIMEOUT_S=5
CONFIG_ESP_TASK_WDT_PANIC=y
CONFIG_LWIP_SNTP_MAX_SERVERS=3
CONFIG_HEATING_ACTUATORS_ENABLED=n
CONFIG_MBEDTLS_CERTIFICATE_BUNDLE=y

CONFIG_HEATING_MQTT_URI="mqtt://192.168.0.1:1883"
CONFIG_HEATING_MQTT_USER=""
CONFIG_HEATING_MQTT_PASSWORD=""

# Vorhandenes Board: ESP32-P4 Revision 3.2; setzt ESP-IDF >=5.5.5 voraus.
CONFIG_ESP32P4_SELECTS_REV_LESS_V3=n
CONFIG_ESP32P4_REV_MIN_301=y

CONFIG_PARTITION_TABLE_CUSTOM=y
CONFIG_PARTITION_TABLE_CUSTOM_FILENAME="partitions.csv"
CONFIG_BOOTLOADER_APP_ROLLBACK_ENABLE=y
CONFIG_ESPTOOLPY_FLASHSIZE_32MB=y

CONFIG_HEATING_TOUCH_DISPLAY=y
CONFIG_SPIRAM=y
CONFIG_SPIRAM_SPEED_200M=y
CONFIG_SPIRAM_USE_MALLOC=y
CONFIG_SPIRAM_IGNORE_NOTFOUND=y
CONFIG_LV_USE_CLIB_MALLOC=y
CONFIG_LV_USE_CLIB_SPRINTF=y
CONFIG_LV_FONT_MONTSERRAT_20=y
CONFIG_LV_FONT_MONTSERRAT_28=y
CONFIG_LV_FONT_MONTSERRAT_40=y

CONFIG_LWIP_NETIF_LOOPBACK=y
CONFIG_ESP_NETIF_LOOPBACK=n
CONFIG_HEATING_TOUCH_PIN="1234"
```
